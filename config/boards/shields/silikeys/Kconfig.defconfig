## config/boards/shields/silikeys/Kconfig.defconfig
```kconfig
if SHIELD_SILIKEYS_LEFT

# Name must be less than 16 characters long!
config ZMK_KEYBOARD_NAME
    default "Silikeys"

config ZMK_SPLIT_ROLE_CENTRAL
    default y

endif

if SHIELD_SILIKEYS_LEFT || SHIELD_SILIKEYS_RIGHT

config ZMK_SPLIT
    default y

endif
```

## config/boards/shields/silikeys/Kconfig.shield
```kconfig
# No whitespace after the comma or in your part name!
config SHIELD_SILIKEYS_LEFT
    def_bool $(shields_list_contains,silikeys_left)

# No whitespace after the comma or in your part name!
config SHIELD_SILIKEYS_RIGHT
    def_bool $(shields_list_contains,silikeys_right)
```
